		  
/**************************Copyleft(C)Liuyalou******************                
**-------------------File Info-------------------------------------
**File Name:     main.c
**Last modified Date:  2017.04.22
**MCU:           STC15W4K48S4
**Last Version:  1.0
**Descriptions:  
**Created by: LYL   
*******************************************************************/
/* 针对液晶模块型号：JLX12864G-573
   串行接口，
   带中文字库IC：JLX-GB2312，竖置横排
   驱动IC是:ST7565R
   
*/
//#include <reg52.H>
//#include <intrins.h>
#include "LCD_init.h"



sbit cs1=P2^1;   //
sbit reset=P2^0; //
sbit rs=P2^4;    //
sbit sid=P2^3;

sbit sclk=P2^2;


void transfer_data(uint16   data1);
void transfer_command(uint16   data1);

void delay(uint16  i);
void Delay1(uint8  i);

uint8 code ascii_table_8x16[95][16];
//uint8 code ascii_table_5x8[95][5];
//uint8 code ascii_table_12x24[][36];
uint8 code ascii_table_8x20[][16];
//uint8 code ascii_table_12x24_6[];





//============initial
void initial_lcd(void)
{
	reset=0;
	delay(100);
	reset=1;
	delay(100);
	
 	transfer_command(0x2c);
 	delay(200);
 	transfer_command(0x2e);
 	delay(200);
	transfer_command(0x2f); //?????
	delay(10);
	
	transfer_command(0xae); //???
	transfer_command(0x38); //????
	transfer_command(0xb8); // FR=1011 => 85Hz
                          // BE[1:0]=1,0 => booster efficiency Level-3	
	transfer_command(0xc8);	//?????	
	transfer_command(0xa0);	//?????
	
	transfer_command(0x54);	//0x54  1/9 bias
	transfer_command(0xf3); //????????
	transfer_command(0x04);
	transfer_command(0x93); //?FRC?PWM??(4frc?15pwm)
	
	transfer_command(0x44); //????COM0 Set initial COM0 register
	transfer_command(0x00);
	transfer_command(0x40); //?????
	transfer_command(0x00);
	transfer_command(0xab); //OSC. ON
	transfer_command(0x67); //DC-DC step up  , 8 times boosting circuit
	
 	transfer_command(0x7b);	//??????3
 	transfer_command(0x11); //????
// 	transfer_command(0x10); //?????
	transfer_command(0x00);	

 	transfer_command(0x24);	//0x24?????,?????0x20~0x27
 	transfer_command(0x81);	//?????
 	transfer_command(0x33);	//36 ???????,?????0x00~0x3f

	transfer_command(0xaf);	//???
}

void lcd_address(uint8  page,uint8  column)
{
	cs1=0;
	column=column-1;
	page=page-1;
	transfer_command(0xb0+page);
	transfer_command(((column>>4)&0x0f)+0x10);
	transfer_command(column&0x0f);
}

//===============clear all dot martrics=============
void clear_screen()
{
   uint8 i,j;
	for(j=0;j<16;j++)
	{
		lcd_address(j+1,1);
		for(i=0;i<128;i++)
		{
			transfer_data(0x00);
		}
	}
}


/*=======写指令========*/
void transfer_command(uint16  data1)   
{
	uint8  i;
	cs1=0;
	rs=0;
	for(i=0;i<8;i++) 
	{
		sclk=0;
		Delay1(2);
		if(data1&0x80) sid=1;
		else sid=0;
		sclk=1;
		Delay1(2);
		data1=data1<<=1;	
	}
	cs1=1;
}

/*--------写数据------------*/
void transfer_data(uint16  data1)
{
	uint8  i;
	cs1=0;
	rs=1;
	for(i=0;i<8;i++)
	{
		sclk=0;
		if(data1&0x80) sid=1;
		else sid=0;
		sclk=1;
		data1=data1<<=1;		
	}
	cs1=1;
}




//=============delay time=====================
void delay(uint16  i)               
{
	uint16  j,k;
	for(j=0;j<i;j++)
	for(k=0;k<990;k++);
}

//=============delay time=====================
void Delay1(uint8 i)
{
	uint8  j,k;
	for(j=0;j<i;j++)
	for(k=0;k<10;k++);
}



/*
void display_16x16(uint8  page,uint8   column,uint8  *dp)
{
	uint8  i,j;
	for(j=0;j<2;j++)
	{
		lcd_address(page+j,column+1);
		for(i=0;i<16;i++)
		{
			transfer_data(*dp);
			dp++;
		}
	}	
}
void display_32x32(uint8 xdata page,uint8 xdata column,uint8  *dp)
{
	xdata uint16 i,j;
	for(j=0;j<4;j++)
	{
		lcd_address(page+j,column+1);
		for(i=0;i<31;i++)
		{
			transfer_data(*dp);
			dp++;
		}
	}	
}
 */
/* 
void display_8x8(uint8 xdata page,uint8 xdata column,uint8 xdata reverse,uint8 *dp)
{
	xdata uint8  j;//i,
//	for(i=0;i<2;i++)
	{
		lcd_address(page,column);
		for(j=0;j<8;j++)
		{
			if(reverse==1)
				transfer_data(~*dp);
			else
				transfer_data(*dp);
			dp++;
		}
	}
} 
*/
void display_string_8x16(uint16  page,uint16  column,uint8 *text)
{
	uint16  i=0,j,k,n;
	cs1=0;
	while(text[i]>0x00)
	{	
		if((text[i]>=0x20)&&(text[i]<=0x7e))
		{
			j=text[i]-0x20;
			for(n=0;n<2;n++)
			{			
				lcd_address(page+n,column);
				for(k=0;k<8;k++)
				{
					transfer_data(ascii_table_8x16[j][k+8*n]);//显示5x7的ASCII字到LCD上，y为页地址，x为列地址，最后为数据
				}
			}
			i++;
			column+=8;
			if(column>127)
			{
				column=0;
				page+=2;
			}
		}
		else
		i++;
	}
}
 

void display_data_8x20(uint8  page,uint8 column,uint8 dat)
{
	uint8  k,n;
	cs1=0;
	
	if(dat >13)  return;
	for(n=0;n<2;n++)
	{			
		lcd_address(page+n,column);
		for(k=0;k<8;k++)
		{
			transfer_data(ascii_table_8x20[dat][k+8*n]);/*显示5x7的ASCII字到LCD上，y为页地址，x为列地址，最后为数据*/
		}
	}
	
}

void TY_display(void)
{
	display_string_8x16(1,8,"Tem:");
	display_string_8x16(3,8,"Hum:");
	display_data_8x20(11,7,0);
}



/* code uint8  dian[]={

//0x06,0x0F,0x0F,0x06,0x00,0x00,0x00,0x00,
	0x00,0x00,0x00,0x78,0x78,0x78,0x78,0x78
}; */
uint8 code dian2[]={
/*--  调入了一幅图像：这是您新建的图像  --*/
/*--  宽度x高度=8x8  --*/
//0x03,0x03,0x00,0x00,0x00,0x00,0x00,0x00,
	0x00,0xF8,0xF8,0xF8,0xF8,0xF8,0xF8,0xF8
};
uint8 code no_dian[]={
0x00,0x00,0x00,0x00,0x00,0x00,0x00,0x00,
};




/* uint8 code ascii_table_12x24_6[]={
   	0xC0,0xF0,0x38,0x0C,0x04,0x04,0x0C,0x7C,  // -6-
	0x78,0x30,0x00,0x00,0xFF,0xFF,0x08,0x04,
	0x02,0x02,0x02,0x06,0x1C,0xF8,0xE0,0x00,
	0x03,0x0F,0x1C,0x30,0x20,0x20,0x20,0x30,
	0x1C,0x0F,0x03,0x00,
}; */
uint8 code ascii_table_8x20[][16]={

0xF8,0x3C,0x06,0x06,0x06,0x06,0xFC,0xF0,0x0F,0x3C,0x20,0x60,0x60,0x30,0x3F,0x0F,/*"0",0*/

0x00,0x10,0x18,0xFC,0xFE,0x00,0x00,0x00,0x00,0x00,0x00,0x7F,0x7F,0x00,0x00,0x00,/*"1",1*/
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0x00,0x00,0x00,0x00,0xC0,0x30,0x0C,0x03,0x60,0x18,0x06,0x01,0x00,0x00,0x00,0x00,/*"/",10*/



};

uint8 code ascii_table_8x16[95][16]={
//粗体8x16点阵的ASCII码的点阵数据，从"JLX-GB2312"型号的字库IC中读出来的国标的。
0x00,0x00,0x00,0x00, 0x00,0x00,0x00,0x00, 0x00,0x00,0x00,0x00, 0x00,0x00,0x00,0x00,		//- -(即“空格”）ASCII码：0X20
0x00,0x00,0x38,0xFC, 0xFC,0x38,0x00,0x00, 0x00,0x00,0x00,0x0D, 0x0D,0x00,0x00,0x00,		//-!-			ASCII码：0X21
0x00,0x0E,0x1E,0x00, 0x00,0x1E,0x0E,0x00, 0x00,0x00,0x00,0x00, 0x00,0x00,0x00,0x00,  	//-"-
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0x08,0x0C,0x04,0x0C, 0x08,0x0C,0x04,0x00, 0x00,0x00,0x00,0x00, 0x00,0x00,0x00,0x00,		//-~-		   ASCII码：0X7E

};

